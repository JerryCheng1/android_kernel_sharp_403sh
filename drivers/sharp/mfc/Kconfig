## drivers/sharp/mfc/Kconfig
```kconfig
#
# FeliCa device configuration
#

menu "FeliCa driver"

comment "SHARP FeliCa device drivers"

config SHFELICA
	bool "FeliCa device drivers"
	depends on SERIAL_MSM_HSL && I2C
	default n
	help
	  Enable FeliCa driver.

config SHSNFC
	bool "NFC device drivers"
	depends on SHFELICA
	default n
	help
	  Enable NFC driver.

config SHSNFC_BATTERY_FIXATION
	bool "MVDD device drivers"
	depends on SHFELICA
	default n
	help
	  Enable MVDD device drivers.

endmenu
```

## drivers/sharp/shaudio/Kconfig
```kconfig
#
# audio device configuration
#
# CONFIG_SH_AUDIO_DRIVER newly created

menu "SHARP audio driver"

comment "SHARP audio drivers"

config SH_AUDIO_DRIVER_MODEL_NUMBER
	int "SH_AUDIO_DRIVER_MODEL_NUMBER"
	range 0 999
	default "0"

config SH_AUDIO_DRIVER
	tristate "SHARP Audio Driver customized"
	default y

#/* SH_AUDIO_DRIVER -> */ /* 16-061 */
config SHRECEIVER_LM48560
	tristate "SHARP receiver lm48560"
	default n
#/* SH_AUDIO_DRIVER <- */ /* 16-061 */

#/* SH_AUDIO_DRIVER -> */ /* 16-062 */
config SH_AUDIO_SMARTAMP
	tristate "SHARP Smart AMP SSM4329"
	default n
#/* SH_AUDIO_DRIVER <- */ /* 16-062 */

endmenu
```

## drivers/sharp/shtps/sy3000/Kconfig
```kconfig
#
# Sharp Touchscreen configuration
#

if TOUCHSCREEN_SHTPS

	config SHTPS_SY3X00_DEV
		tristate "SY3x00 Device"
		default n
		depends on TOUCHSCREEN_SHTPS

	config SHTPS_SY3000_PLG484_001
		tristate "SY3000 PLG484-001"
		default n
		depends on SHTPS_SY3X00_DEV

	config SHTPS_SY3000_PLG500_001
		tristate "SY3000 PLG500-001"
		default n
		depends on SHTPS_SY3X00_DEV

endif # TOUCHSCREEN_SHTPS
```
